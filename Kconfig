## Kconfig
```kconfig
#
# For a description of the syntax of this configuration file,
# see kconfig-language at https://www.kernel.org/doc/Documentation/kbuild/kconfig-language.txt
#

menu "Helix Advanced Audio Codec"

config CODEC_HELIXAAC
	bool "The Helix Advanced Audio Codec Library"
	default n
	---help---
		Enable support for the Helix Advanced Audio Codec library

if CODEC_HELIXAAC

config CODEC_HELIXAAC_SBR
	bool "AAC-Spectral Band Replication"
	default n
	---help---
		Enable support for the AAC-PlusV1-SBR.

endif

endmenu
```
